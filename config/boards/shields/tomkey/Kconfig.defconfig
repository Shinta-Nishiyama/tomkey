## config/boards/shields/tomkey/Kconfig.defconfig
```kconfig
# Copyright (c) 2024
# SPDX-License-Identifier: MIT

if SHIELD_TOMKEY_L || SHIELD_TOMKEY_R || SHIELD_TOMKEY

config ZMK_KEYBOARD_NAME
    default "tomkeyLk"

if SHIELD_TOMKEY_L || SHIELD_TOMKEY

config ZMK_SPLIT
    default y

config ZMK_SPLIT_ROLE_CENTRAL
    default y

endif # SHIELD_TOMKEY_L || SHIELD_TOMKEY

if SHIELD_TOMKEY_R

config ZMK_SPLIT
    default y

endif # SHIELD_TOMKEY_R

if ZMK_DISPLAY

config I2C
    default y

config SSD1306
    default y

endif # ZMK_DISPLAY

config ZMK_MOUSE
    default y

config PMW3610
    default y if SHIELD_TOMKEY_L || SHIELD_TOMKEY_R

endif # SHIELD_TOMKEY_L || SHIELD_TOMKEY_R || SHIELD_TOMKEY
```

## config/boards/shields/tomkey/Kconfig.shield
```kconfig
# Copyright (c) 2024
# SPDX-License-Identifier: MIT

config SHIELD_TOMKEY_L
    def_bool $(shields_list_contains,tomkey_L)

config SHIELD_TOMKEY_R
    def_bool $(shields_list_contains,tomkey_R)

config SHIELD_TOMKEY
    def_bool $(shields_list_contains,tomkey)
```
